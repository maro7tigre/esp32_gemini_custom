## lib/esp32_camera/Kconfig
```kconfig
menu "Camera configuration"

    config OV2640_SUPPORT
        bool "Support OV2640 2MP"
        default y
        help
            Enable this option for OV2640 support.

    config CAMERA_TASK_STACK_SIZE
        int "CAM task stack size"
        default 2048
        help
            Camera task stack size

    choice CAMERA_TASK_PINNED_TO_CORE
        bool "Camera task pinned to core"
        default CAMERA_CORE0
        help
            Pin the camera handle task to a certain core(0/1). It can also be done automatically choosing NO_AFFINITY.

        config CAMERA_CORE0
            bool "CORE0"
        config CAMERA_CORE1
            bool "CORE1"
        config CAMERA_NO_AFFINITY
            bool "NO_AFFINITY"

    endchoice

    config CAMERA_DMA_BUFFER_SIZE_MAX
        int "DMA buffer size"
        range 8192 32768
        default 32768
        help
            Maximum value of DMA buffer
            Larger values may fail to allocate due to insufficient contiguous memory blocks, and smaller value may cause DMA interrupt to be too frequent.

    config CAMERA_JPEG_MODE_FRAME_SIZE
        int "Default JPEG mode frame size (bytes)"
        default 8192
        help
            This option sets the default frame size in JPEG mode.
            Specify the desired buffer size in bytes (8192 is a good starting point).

endmenu
```
